## drivers/extremerom/Kconfig
```kconfig
# SPDX-License-Identifier: GPL-2.0

config EXTREMEROM_WORKAROUNDS
	tristate "ExtremeROM workaround framework"
	default n

config ONEUI7_WORKAROUND
 	depends on EXYNOS_DECON_LCD
 	tristate "Multiply brightness value by 100 for OneUI 7 ROM ports"
	select EXTREMEROM_WORKAROUNDS
 	default n
```
